// Settings tuned for 3840 x 2160 display resolution
#define ZMK_POINTING_DEFAULT_MOVE_VAL 1500 // 600
#define ZMK_POINTING_DEFAULT_SCRL_VAL 10  // 10

#include <dt-bindings/zmk/pointing.h>
#include <behaviors.dtsi>
#include <behaviors/num_word.dtsi> // requires auto-layer module
#include <dt-bindings/zmk/keys.h>
#include <dt-bindings/zmk/bt.h>
#include <dt-bindings/zmk/outputs.h>
#include "mouse.dtsi"


// Config from @caksoylar, defaults in comments
&mmv {
  acceleration-exponent = <1>;          // 1
  time-to-max-speed-ms = <1000>;         // 300
  delay-ms = <200>;                     // 0
};

&msc {
  acceleration-exponent = <2>;          // 0
  time-to-max-speed-ms = <800>;         // 300
  delay-ms = <200>;                     // 0
};

