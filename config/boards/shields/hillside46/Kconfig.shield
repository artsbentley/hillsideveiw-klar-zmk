## config/boards/shields/hillside46/Kconfig.shield
```kconfig
# Copyright (c) 2022 The ZMK Contributors
# SPDX-License-Identifier: MIT

config SHIELD_HILLSIDE_VIEW_LEFT
    def_bool $(shields_list_contains,hillside46_left)

config SHIELD_HILLSIDE_VIEW_RIGHT
    def_bool $(shields_list_contains,hillside46_right)
```
